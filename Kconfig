## Kconfig
```kconfig
menu “OpenWRT Drivers for MediaTek”
config USB-HOST-DRIVER-MT
	tristate “USB-HOST-DRIVER-MT”
	Default n
config THERMAL-DRIVER-MT
	tristate “THERMAL-DRIVER-MT”
	Default n
config PCI-DRIVER-MT
	tristate “PCI-DRIVER-MT”
	Default n
config NET-DRIVER-MT
	tristate “NET-DRIVER-MT”
	Default n
config MTD-DRIVER-MT
	tristate “MTD-DRIVER-MT”
	Default n
config LED-DRIVER-MT
	tristate “LED-DRIVER-MT”
	Default n
config CLK-DRIVER-MT
	tristate "CLK-DRIVER-MT”
	Default n
source /mnt/ext/OpenWrt_BPI-R3/drivers/Kconfig
endmenu
```
